## src/drivers/encoder/Kconfig
```kconfig
menu "Encoder"
    menuconfig COMMON_ENCODER
        bool "Encoder sensors"
        default n
        select DRIVERS_ENCODER_AS5600
        ---help---
            Enable default set of encoder sensors
    rsource "*/Kconfig"
endmenu #Encoder
```

## src/drivers/encoder/as5600/Kconfig
```kconfig
menuconfig DRIVERS_ENCODER_AS5600
	bool "AS5600 magnetic encoder"
	default n
	---help---
		Enable support for AS5600 I2C magnetic rotary encoder
```

## src/drivers/hall_gpio/Kconfig
```kconfig
menuconfig DRIVERS_HALL_GPIO
	bool "hall_gpio"
	default n
	---help---
		Enable GPIO-based Hall sensor pulse capture driver.

if DRIVERS_HALL_GPIO

config HALL_GPIO_PULSES_PER_REV_DEFAULT
	int "Default pulses per revolution"
	default 1
	help
		Default pulses per mechanical revolution when not provided on CLI.

endif
```

## src/examples/flap_rpm_controller/Kconfig
```kconfig
menuconfig EXAMPLES_FLAP_RPM_CONTROLLER
	bool "flap_rpm_controller"
	default n
	---help---
	  Flapping main-wing RPM controller using Peripheral via Actuator SetX.
```

## src/modules/airspeed_injector/Kconfig
```kconfig
menuconfig MODULES_AIRSPEED_INJECTOR
	bool "airspeed_injector"
	default n
	---help---
		Enable support for SITL differential pressure airspeed injector
```

## src/modules/flap_aug_shadow/Kconfig
```kconfig
menuconfig MODULES_FLAP_AUG_SHADOW
	bool "flap_aug_shadow"
	default n
	---help---
		Read, compute and log frozen V2 and engineering-only V3 Shadow diagnostics.
		This module has no actuator publication or injection path.

if MODULES_FLAP_AUG_SHADOW

endif
```

## src/modules/fw_mode_manager/Kconfig
```kconfig
menuconfig MODULES_FW_MODE_MANAGER
	bool "fw_mode_manager"
	default n
	---help---
		Enable fixed-wing mode manager (NPFG/L1/PID guidance + longitudinal configuration).

menuconfig USER_FW_MODE_MANAGER
	bool "fw_mode_manager running as userspace module"
	default n
	depends on BOARD_PROTECTED && MODULES_FW_MODE_MANAGER
	---help---
		Run fw_mode_manager in userspace memory (protected build).
```

## src/modules/rpm_pid/Kconfig
```kconfig
menuconfig MODULES_RPM_PID
	bool "rpm_pid"
	default n
	---help---
		Flapping wing frequency / motor RPM PID controller
```

## src/modules/wing_phase/Kconfig
```kconfig
menuconfig MODULES_WING_PHASE
	bool "wing_phase"
	default n
	---help---
		Compute Hall-indexed flapping phase from encoder counts and Hall index pulses.

if MODULES_WING_PHASE

endif
```
